## drivers/oplus/Kconfig
```kconfig
# SPDX-License-Identifier: GPL-2.0-only
# Copyright (C) 2018-2020 Oplus. All rights reserved.

config OPLUS_OPROJECT
	bool "oplus project"
	depends on E404_OPLUS
	default y
	help
	 define this config to define oplus project
	  
config OPLUS_NANDSWAP
	bool "nandswap feature"
	depends on E404_OPLUS
	default n
	help
	 nandswap feature

config OPLUS_NANDSWAP_DEBUG
	bool "nandswap debug"
	depends on E404_OPLUS && F2FS_FS
	default n
	help
	 nandswap debug

config OPLUS_NWPOWER
    bool "OPLUS NWPOWER"
    depends on E404_OPLUS
    default n
    help
	 add for oplus wakelock_profiler

config OPLUS_SUBSYS_SLEEP_MONITOR
	bool "monitor Qualcomm subsystem sleep"
	depends on E404_OPLUS
	default n
	help
	  This selects to get sleep info for Qualcomm subsystem

config OPLUS_WAKELOCK_PROFILER
	bool "config oplus wakelock profiler"
	depends on E404_OPLUS
	default n
	help
		Select this config to enable oplus wakelock profiler

config OPLUS_POWERINFO_STANDBY_DEBUG
	bool "powerinfo standby config"
	depends on E404_OPLUS
	default n
	help
		Select this config to enable powerinfo standby debug

config OPLUS_POWERINFO_RPMH
	bool "powerinfo rpmh config"
	depends on E404_OPLUS
	default n
	help
		Select this config to enable powerinfo rpmh

config OPLUS_POWERINFO_FTM
	bool "powerinfo ftm config"
	depends on E404_OPLUS
	default n
	help
		Select this config to enable powerinfo ftm
	
config OPLUS_STUB_NODES
	bool "oplus missing nodes stubs"
	depends on E404_OPLUS
	default y
	help
	 Select this to enable dummy stubs for missing oplus procfs and sysfs nodes
```
